/*
  (c) 2022 Chris Royle
    This program is free software: you can redistribute it and/or modify
    it under the terms of the GNU General Public License as published by
    the Free Software Foundation, either version 3 of the License, or
    (at your option) any later version.

    This program is distributed in the hope that it will be useful,
    but WITHOUT ANY WARRANTY; without even the implied warranty of
    MERCHANTABILITY or FITNESS FOR A PARTICULAR PURPOSE.  See the
    GNU General Public License for more details.

    You should have received a copy of the GNU General Public License
    along with this program.  If not, see <https://www.gnu.org/licenses/>.
*/

/dts-v1/;
/plugin/;


/ {

	compatible = "brcm,bcm2711", "brcm,bcm2837", "brcm,bcm2710";

	/* Create an econet-gpio driver instance */

	fragment@0 {
		target-path = "/";
		__overlay__ {
			econet_gpio: econet@0 {
				label = "ECONET-GPIO";
				compatible = "econet-gpio";
				clk-gpios = <&gpio 4 0>;
				cs-gpios = <&gpio 5 0>;
				rw-gpios = <&gpio 6 0>;
				addr-gpios = <&gpio 12 0>, <&gpio 13 0>;
				busy-gpios = <&gpio 16 0>;
				irq-gpios = <&gpio 17 0>;
				csr-gpios = <&gpio 18 0>;
				rst-gpios = <&gpio 19 0>;
				data-gpios = <&gpio 20 0>, 
						<&gpio 21 0>,
						<&gpio 22 0>,
						<&gpio 23 0>,
						<&gpio 24 0>,
						<&gpio 25 0>,
						<&gpio 26 0>,
						<&gpio 27 0>;
				status = "okay";
			};
		};
	};

};


